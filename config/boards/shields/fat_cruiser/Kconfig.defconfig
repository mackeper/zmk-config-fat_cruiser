## config/boards/shields/fat_cruiser/Kconfig.defconfig
```kconfig
if SHIELD_FAT_CRUISER

    config ZMK_KEYBOARD_NAME
        default "fat_cruiser"

endif

if ZMK_DISPLAY

config I2C
    default y

config SSD1306
    default y

endif
```

## config/boards/shields/fat_cruiser_v2/Kconfig.shield
```kconfig
config SHIELD_FAT_CRUISER_V2
    def_bool $(shields_list_contains,fat_cruiser_v2)
```
